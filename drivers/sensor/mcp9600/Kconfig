## drivers/sensor/mcp9600/Kconfig
```kconfig
# MCP9600 Thermocouple temperature converter configuration options


# SPDX-License-Identifier: Apache-2.0

menuconfig MCP9600
	bool "MCP9600 Thermocouple EMF to temperature converter"
	depends on I2C
	help
	  Enable driver for MCP9600 Thermocouple converter.
```
